## CMakeLists.txt
```
# SPDX-License-Identifier: Apache-2.0

cmake_minimum_required(VERSION 3.20.0)
find_package(Zephyr REQUIRED HINTS $ENV{ZEPHYR_BASE})
project(blinky)

file(SHA256 ${CMAKE_CURRENT_LIST_DIR}/src/main.c CHECKSUM_VARIABLE)

add_custom_command(
  OUTPUT ${CMAKE_CURRENT_LIST_DIR}/src/hash.h
  COMMAND sha1sum -b ${CMAKE_CURRENT_LIST_DIR}/src/data.h > ${CMAKE_CURRENT_BINARY_DIR}/_tmp.hash1
  COMMAND head -c 16 ${CMAKE_CURRENT_BINARY_DIR}/_tmp.hash1 > ${CMAKE_CURRENT_BINARY_DIR}/_tmp.hash2
  COMMAND echo -n "#define DATA_HASH 0x" > ${CMAKE_CURRENT_LIST_DIR}/src/hash.h
  COMMAND cat ${CMAKE_CURRENT_BINARY_DIR}/_tmp.hash2 >> ${CMAKE_CURRENT_LIST_DIR}/src/hash.h
  COMMAND echo "uLL" >> ${CMAKE_CURRENT_LIST_DIR}/src/hash.h
  DEPENDS ${CMAKE_CURRENT_LIST_DIR}/src/data.h
  VERBATIM)

target_sources(app PRIVATE src/main.c src/multiproto.c src/calendar.c src/radio.c src/ble.c src/blecmd.c src/data.c src/hash.h)
```

## prj.conf
```kconfig
CONFIG_GPIO=y

CONFIG_BT=y
CONFIG_BT_PERIPHERAL=y
CONFIG_BT_DEVICE_NAME="Temp. sensors hub"

CONFIG_MPSL=y
CONFIG_MPSL_TIMESLOT_SESSION_COUNT=1

CONFIG_BT_PERIPHERAL_PREF_MIN_INT=96
CONFIG_BT_PERIPHERAL_PREF_MAX_INT=160
CONFIG_BT_PERIPHERAL_PREF_TIMEOUT=1600
```

## src/main.c
```c
#include <zephyr/kernel.h>
#include <zephyr/logging/log.h>
#include <zephyr/drivers/gpio.h>
#include <zephyr/bluetooth/bluetooth.h>
#include <zephyr/bluetooth/hci.h>
#include <zephyr/bluetooth/conn.h>
#include <zephyr/bluetooth/uuid.h>
#include <zephyr/bluetooth/gatt.h>
#include <mpsl/mpsl_work.h>
#include <mpsl_timeslot.h>
#include <mpsl.h>
#include <hal/nrf_timer.h>

#include "calendar.h"
#include "multiproto.h"
#include "leds.h"
#include "radio.h"
#include "ble.h"
#include "data.h"

#define LOG_LEVEL CONFIG_DEFAULT_LOG_LEVEL
#include <zephyr/logging/log.h>
LOG_MODULE_REGISTER(temp_main);

#define NO_CHANNEL  0xFF
#define TEMPERATURE_NO_VALUE 0x7FFF
#define VOLTAGE_NO_VALUE 0x7FFF


static const char* day_names[7] = {
	"Sun", "Mon", "Tue", "Wed", "Thu", "Fri", "Sat",
};


static void packets_queue_handler(struct k_work *work);


K_MSGQ_DEFINE(packets_queue, sizeof(OutputPacket), 8, 4);
K_WORK_DEFINE(packets_queue_work, packets_queue_handler);


void packet_received(OutputPacket* packet)
{
	int err = k_msgq_put(&packets_queue, packet, K_NO_WAIT);
	if (err != 0) {
		LOG_WRN("Packet dropped - queue overrun!");
	} else {
		k_work_submit(&packets_queue_work);
	}
}

int get_up_time() {
	return (int)(k_uptime_get() / 1000LL);
}

static int16_t min_of_channel(int channel_index) {
	int16_t result = 0x7FFF;
	for (int i = 0; i < data_config.node_count; i++) {
		ConfigNode* config_node = &data_config.nodes[i];
		StateNode* state_node = &data_state.nodes[i];
		if (config_node->channel != channel_index) {
			continue;
		}
		if (state_node->temperature == TEMPERATURE_NO_VALUE) {
			return TEMPERATURE_NO_VALUE;
		}
		if (state_node->temperature < result) {
			result = state_node->temperature;
		}
	}
	if (result == 0x7FFF) {
		return TEMPERATURE_NO_VALUE;
	}
	return result;
}

static int16_t max_of_channel(int channel_index) {
	int16_t result = -0x7FFF;
	for (int i = 0; i < data_config.node_count; i++) {
		ConfigNode* config_node = &data_config.nodes[i];
		StateNode* state_node = &data_state.nodes[i];
		if (config_node->channel != channel_index) {
			continue;
		}
		if (state_node->temperature == TEMPERATURE_NO_VALUE) {
			return TEMPERATURE_NO_VALUE;
		}
		if (state_node->temperature > result) {
			result = state_node->temperature;
		}
	}
	if (result == -0x7FFF) {
		return TEMPERATURE_NO_VALUE;
	}
	return result;
}

static int16_t avg_of_channel(int channel_index) {
	int32_t result = 0;
	int32_t count = 0;
	for (int i = 0; i < data_config.node_count; i++) {
		ConfigNode* config_node = &data_config.nodes[i];
		StateNode* state_node = &data_state.nodes[i];
		if (config_node->channel != channel_index) {
			continue;
		}
		if (state_node->temperature == TEMPERATURE_NO_VALUE) {
			return TEMPERATURE_NO_VALUE;
		}
		result += state_node->temperature;
		count++;
	}
	if (count == 0) {
		return TEMPERATURE_NO_VALUE;
	}
	return (result + (count / 2)) / count;
}

static void packet_received_on_work(OutputPacket* packet)
{
	if (data_state.time_shift == 0) {
		int sec = (int)(k_uptime_get() / 1000LL);
		int min = sec / 60; sec %= 60;
		int hour = min / 60; min %= 60;
		int day = hour / 24; hour %= 24;
		printk("%d %02d:%02d:%02d %d\n", day, hour, min, sec, data_state.time_shift);
	} else {
		static DateTime dt;
		uint64_t time = k_uptime_get() / 1000LL + (uint64_t)data_state.time_shift;
		convert_time_tz(time, &dt, &data_config.time_zone);
		printk("%d-%02d-%02d %s %02d:%02d:%02d\n", dt.year, dt.month, dt.day, day_names[dt.day_of_week],
			dt.hour, dt.min, dt.sec);
	}
	int t = packet->temp;
	int v = packet->voltage;
	printk("Node: %04X%08X\n", packet->address_high, packet->address_low);
	printk("Temperature: %d.%d%d*C\n", t / 100, (t / 10) % 10, t % 10);
	printk("Voltage: %d.%d%dV\n", v / 100, (v / 10) % 10, v % 10);

	ConfigNode* config_node = NULL;
	StateNode* state_node = NULL;
	int node_index = -1;

	for (int i = 0; i < data_config.node_count; i++)
	{
		ConfigNode* n = &data_config.nodes[i];
		if (n->addr_high == packet->address_high && n->addr_low == packet->address_low) {
			node_index = i;
			config_node = n;
			state_node = &data_state.nodes[i];
			break;
		}
	}

	if (config_node == NULL) {
		if (data_config.node_count < ARRAY_SIZE(data_config.nodes)) {
			node_index = data_config.node_count;
			config_node = &data_config.nodes[node_index];
			state_node = &data_state.nodes[node_index];
			config_node->addr_high = packet->address_high;
			config_node->addr_low = packet->address_low;
			config_node->channel = NO_CHANNEL;
			strcpy(config_node->name, "[no name]");
			state_node->last_update = 0;
			state_node->temperature = TEMPERATURE_NO_VALUE;
			state_node->voltage = VOLTAGE_NO_VALUE;
			printk("New node added %04X%08X at %d\n", config_node->addr_high, config_node->addr_low, node_index);
			data_config.node_count++;
		} else {
			LOG_ERR("Too many nodes!");
			printk("Too many nodes!\n");
			return;
		}
	}

	printk("Node %d %s\n", node_index, config_node->name);

	state_node->last_update = get_up_time();
	state_node->temperature = packet->temp;
	state_node->voltage = packet->voltage;

	if (config_node->channel < ARRAY_SIZE(data_config.channels)) {
		ConfigChannel *config_channel = &data_config.channels[config_node->channel];
		StateChannel *state_channel = &data_state.channels[config_node->channel];
		switch (config_channel->func)
		{
		case FUNC_MIN:
			state_channel->temperature = min_of_channel(config_node->channel);
			break;
		case FUNC_MAX:
			state_channel->temperature = max_of_channel(config_node->channel);
			break;
		case FUNC_AVG:
			state_channel->temperature = avg_of_channel(config_node->channel);
			break;
		default:
			break;
		}
		printk("Channel %d %s temperature: %d.%d%d*C\n", config_node->channel, config_channel->name, t / 100, (t / 10) % 10, t % 10);
	}

}

static void packets_queue_handler(struct k_work *work)
{
	int err;
	OutputPacket packet;
	do {
		err = k_msgq_get(&packets_queue, &packet, K_NO_WAIT);
		if (err == 0) {
			packet_received_on_work(&packet);
		}
	} while (err == 0);
}

void main(void)
{
	printk("START\n");

	data_init();

	leds_init();

	ble_init();

	multiproto_init();
}


#ifdef TEMP23409304

void main_control()
{
	AWAIT_BEGIN();

	if (t < t_min) {
		heat_on();
		goto on_state;
	} else {
		heat_off();
	}

	while (true) {

		do {
			AWAIT;
			if (t >= t_min) return;
			set_timeout(17);
			AWAIT;
			if (timeout) break;
			if (t < t_min) return;
		} while (true);

		heat_on();

		set_timeout(30);
		AWAIT;
		if (!timeout) return;

		wather_on();

		set_timeout(2);
		AWAIT;
		if (!timeout) return;

		wather_off();

		set_timeout(15);
		AWAIT;
		if (!timeout) return;

on_state:
		do {
			AWAIT;
			if (t <= t_max) return;
			set_timeout(12);
			AWAIT;
			if (timeout) break;
			if (t > t_max) return;
		} while (true);

		heat_off();

	}

}

#endif
```

## src/SEGGER_RTT_Conf.h
```c
/*********************************************************************
*                    SEGGER Microcontroller GmbH                     *
*                        The Embedded Experts                        *
**********************************************************************
*                                                                    *
*            (c) 1995 - 2020 SEGGER Microcontroller GmbH             *
*                                                                    *
*       www.segger.com     Support: support@segger.com               *
*                                                                    *
**********************************************************************
*                                                                    *
*       SEGGER RTT * Real Time Transfer for embedded targets         *
*                                                                    *
**********************************************************************
*                                                                    *
* All rights reserved.                                               *
*                                                                    *
* SEGGER strongly recommends to not make any changes                 *
* to or modify the source code of this software in order to stay     *
* compatible with the RTT protocol and J-Link.                       *
*                                                                    *
* Redistribution and use in source and binary forms, with or         *
* without modification, are permitted provided that the following    *
* condition is met:                                                  *
*                                                                    *
* o Redistributions of source code must retain the above copyright   *
*   notice, this condition and the following disclaimer.             *
*                                                                    *
* THIS SOFTWARE IS PROVIDED BY THE COPYRIGHT HOLDERS AND             *
* CONTRIBUTORS "AS IS" AND ANY EXPRESS OR IMPLIED WARRANTIES,        *
* INCLUDING, BUT NOT LIMITED TO, THE IMPLIED WARRANTIES OF           *
* MERCHANTABILITY AND FITNESS FOR A PARTICULAR PURPOSE ARE           *
* DISCLAIMED. IN NO EVENT SHALL SEGGER Microcontroller BE LIABLE FOR *
* ANY DIRECT, INDIRECT, INCIDENTAL, SPECIAL, EXEMPLARY, OR           *
* CONSEQUENTIAL DAMAGES (INCLUDING, BUT NOT LIMITED TO, PROCUREMENT  *
* OF SUBSTITUTE GOODS OR SERVICES; LOSS OF USE, DATA, OR PROFITS;    *
* OR BUSINESS INTERRUPTION) HOWEVER CAUSED AND ON ANY THEORY OF      *
* LIABILITY, WHETHER IN CONTRACT, STRICT LIABILITY, OR TORT          *
* (INCLUDING NEGLIGENCE OR OTHERWISE) ARISING IN ANY WAY OUT OF THE  *
* USE OF THIS SOFTWARE, EVEN IF ADVISED OF THE POSSIBILITY OF SUCH   *
* DAMAGE.                                                            *
*                                                                    *
**********************************************************************
---------------------------END-OF-HEADER------------------------------
File    : SEGGER_RTT_Conf.h
Purpose : Implementation of SEGGER real-time transfer (RTT) which
          allows real-time communication on targets which support
          debugger memory accesses while the CPU is running.
Revision: $Rev: 24316 $

*/

#ifndef SEGGER_RTT_CONF_H
#define SEGGER_RTT_CONF_H

#ifdef __IAR_SYSTEMS_ICC__
  #include <intrinsics.h>
#endif

/*********************************************************************
*
*       Defines, configurable
*
**********************************************************************
*/

//
// Take in and set to correct values for Cortex-A systems with CPU cache
//
//#define SEGGER_RTT_CPU_CACHE_LINE_SIZE            (32)          // Largest cache line size (in bytes) in the current system
//#define SEGGER_RTT_UNCACHED_OFF                   (0xFB000000)  // Address alias where RTT CB and buffers can be accessed uncached
//
// Most common case:
// Up-channel 0: RTT
// Up-channel 1: SystemView
//
#ifndef   SEGGER_RTT_MAX_NUM_UP_BUFFERS
  #define SEGGER_RTT_MAX_NUM_UP_BUFFERS             (2)     // Max. number of up-buffers (T->H) available on this target    (Default: 3)
#endif
//
// Most common case:
// Down-channel 0: RTT
// Down-channel 1: SystemView
//
#ifndef   SEGGER_RTT_MAX_NUM_DOWN_BUFFERS
  #define SEGGER_RTT_MAX_NUM_DOWN_BUFFERS           (2)     // Max. number of down-buffers (H->T) available on this target  (Default: 3)
#endif

#ifndef   BUFFER_SIZE_UP
  #define BUFFER_SIZE_UP                            (512)  // Size of the buffer for terminal output of target, up to host (Default: 1k)
#endif

#ifndef   BUFFER_SIZE_DOWN
  #define BUFFER_SIZE_DOWN                          (16)    // Size of the buffer for terminal input to target from host (Usually keyboard input) (Default: 16)
#endif

#ifndef   SEGGER_RTT_PRINTF_BUFFER_SIZE
  #define SEGGER_RTT_PRINTF_BUFFER_SIZE             (128u)    // Size of buffer for RTT printf to bulk-send chars via RTT     (Default: 64)
#endif

#ifndef   SEGGER_RTT_MODE_DEFAULT
  #define SEGGER_RTT_MODE_DEFAULT                   SEGGER_RTT_MODE_NO_BLOCK_SKIP // Mode for pre-initialized terminal channel (buffer 0)
#endif

/*********************************************************************
*
*       RTT memcpy configuration
*
*       memcpy() is good for large amounts of data,
*       but the overhead is big for small amounts, which are usually stored via RTT.
*       With SEGGER_RTT_MEMCPY_USE_BYTELOOP a simple byte loop can be used instead.
*
*       SEGGER_RTT_MEMCPY() can be used to replace standard memcpy() in RTT functions.
*       This is may be required with memory access restrictions,
*       such as on Cortex-A devices with MMU.
*/
#ifndef   SEGGER_RTT_MEMCPY_USE_BYTELOOP
  #define SEGGER_RTT_MEMCPY_USE_BYTELOOP              0 // 0: Use memcpy/SEGGER_RTT_MEMCPY, 1: Use a simple byte-loop
#endif
//
// Example definition of SEGGER_RTT_MEMCPY to external memcpy with GCC toolchains and Cortex-A targets
//
//#if ((defined __SES_ARM) || (defined __CROSSWORKS_ARM) || (defined __GNUC__)) && (defined (__ARM_ARCH_7A__))
//  #define SEGGER_RTT_MEMCPY(pDest, pSrc, NumBytes)      SEGGER_memcpy((pDest), (pSrc), (NumBytes))
//#endif

/*********************************************************************
*
*       RTT lock configuration fallback
*/
#ifndef   SEGGER_RTT_LOCK
  #define SEGGER_RTT_LOCK()                // Lock RTT (nestable)   (i.e. disable interrupts)
#endif

#ifndef   SEGGER_RTT_UNLOCK
  #define SEGGER_RTT_UNLOCK()              // Unlock RTT (nestable) (i.e. enable previous interrupt lock state)
#endif

#endif
/*************************** End of file ****************************/
```

## src/ble.c
```c
#include <zephyr/kernel.h>
#include <zephyr/logging/log.h>
#include <zephyr/drivers/gpio.h>
#include <zephyr/bluetooth/bluetooth.h>
#include <zephyr/bluetooth/hci.h>
#include <zephyr/bluetooth/conn.h>
#include <zephyr/bluetooth/uuid.h>
#include <zephyr/bluetooth/gatt.h>
#include <mpsl/mpsl_work.h>
#include <mpsl_timeslot.h>
#include <mpsl.h>
#include <hal/nrf_timer.h>

#include "calendar.h"
#include "multiproto.h"
#include "leds.h"
#include "radio.h"
#include "ble.h"

#define LOG_LEVEL CONFIG_DEFAULT_LOG_LEVEL
#include <zephyr/logging/log.h>
LOG_MODULE_REGISTER(temp_ble);

#define REQUEST_SIZE 512
#define RESPONSE_SIZE 512

#define CHUNK_SIZE 16
#define CHUNK_FLAG_BEGIN 0x40
#define CHUNK_FLAG_END 0x80
#define CHUNK_ID_MASK 0x3F

#define BT_UUID_CUSTOM_SERVICE_VAL BT_UUID_128_ENCODE(0xCC2AF14A, 0x2AAF, 0x4C6E, 0xB2E4, 0x3856EE2B4267)

static struct bt_uuid_128 vnd_uuid = BT_UUID_INIT_128(BT_UUID_CUSTOM_SERVICE_VAL);

static struct bt_uuid_128 vnd_ept_uuid = BT_UUID_INIT_128(BT_UUID_128_ENCODE(0x45CC8E0B, 0x8507, 0x45F7, 0xAC95, 0xB798D0FD732A));

static const struct bt_data ad[] = {
	BT_DATA_BYTES(BT_DATA_FLAGS, (BT_LE_AD_GENERAL | BT_LE_AD_NO_BREDR)),
	BT_DATA_BYTES(BT_DATA_UUID128_ALL, BT_UUID_CUSTOM_SERVICE_VAL),
};


static uint8_t ble_request[REQUEST_SIZE];
static volatile int ble_request_size = 0;
static uint8_t request_id = 255;
static int request_offset = 0;


static uint8_t ble_response[RESPONSE_SIZE];
static volatile int ble_response_size = 0;
static uint8_t response_id = 255;
static int response_offset = 0;


static ssize_t read_vnd(struct bt_conn *conn, const struct bt_gatt_attr *attr,
			void *buf, uint16_t len, uint16_t offset)
{
	int response_size_copy;
	uint8_t temp[1 + CHUNK_SIZE];
	LOG_DBG("GATT read %d bytes at %d", len, offset);

	if (offset != 0 || len <= 1 + CHUNK_SIZE) {
		LOG_DBG("GATT read INVALID");
		return BT_GATT_ERR(BT_ATT_ERR_INVALID_OFFSET);
	}

	temp[0] = response_id;

	__DMB();
	response_size_copy = ble_response_size;
	__DMB();

	if (response_size_copy == 0) {
		return bt_gatt_attr_read(conn, attr, buf, len, offset, temp, 0);
	} else if (response_offset >= response_size_copy) {
		temp[0] |= CHUNK_FLAG_END;
		return bt_gatt_attr_read(conn, attr, buf, len, offset, temp, 1);
	}

	int send_size = response_size_copy - response_offset;
	if (send_size > CHUNK_SIZE) {
		send_size = CHUNK_SIZE;
	}

	if (response_offset == 0) {
		temp[0] |= CHUNK_FLAG_BEGIN;
	}
	memcpy(&temp[1], &ble_response[response_offset], send_size);
	response_offset += send_size;
	if (response_offset == response_size_copy) {
		temp[0] |= CHUNK_FLAG_END;
	}

	return bt_gatt_attr_read(conn, attr, buf, len, offset, temp, 1 + send_size);
}


static ssize_t write_vnd(struct bt_conn *conn, const struct bt_gatt_attr *attr,
			 const void *buf, uint16_t len, uint16_t offset,
			 uint8_t flags)
{
	LOG_DBG("GATT write %d bytes at %d", len, offset);

	int err = 0;
	uint8_t* input = (uint8_t*)buf + 1;
	int input_len = len - 1;
	uint8_t input_flags = input[-1];

	if (offset != 0) {
		err = BT_GATT_ERR(BT_ATT_ERR_INVALID_OFFSET);
		goto error;
	} else if (input_len > CHUNK_SIZE || input_len < 0) {
		err = BT_GATT_ERR(BT_ATT_ERR_INVALID_ATTRIBUTE_LEN);
		goto error;
	} else if (input_flags & CHUNK_FLAG_BEGIN) {
		request_id = input_flags & CHUNK_ID_MASK;
		request_offset = 0;
		__DMB();
		ble_request_size = 0;
		__DMB();
	} else if ((input_flags & CHUNK_ID_MASK) != request_id) {
		err = BT_GATT_ERR(BT_ATT_ERR_VALUE_NOT_ALLOWED);
		goto error;
	}

	if (request_offset + input_len > sizeof(ble_request)) {
		err = BT_GATT_ERR(BT_ATT_ERR_INVALID_ATTRIBUTE_LEN);
		goto error;
	}

	memcpy(&ble_request[request_offset], input, input_len);
	request_offset += input_len;

	if (input_flags & CHUNK_FLAG_END) {
		__DMB();
		ble_request_size = request_offset;
		ble_response_size = 0;
		__DMB();
		response_id = request_id;
		response_offset = 0;
		request_id = 255;
		request_offset = 0;
		ble_packet();
	}

	return len;

error:
	request_id = 255;
	request_offset = 0;
	__DMB();
	ble_request_size = 0;
	__DMB();
	return err;
}


BT_GATT_SERVICE_DEFINE(vnd_svc,
	BT_GATT_PRIMARY_SERVICE(&vnd_uuid),
	BT_GATT_CHARACTERISTIC(&vnd_ept_uuid.uuid,
			       BT_GATT_CHRC_READ | BT_GATT_CHRC_WRITE,
			       BT_GATT_PERM_READ | BT_GATT_PERM_WRITE,
			       read_vnd, write_vnd, NULL),
);


void ble_init()
{
	int ret;
	ret = bt_enable(NULL);
	if (ret) {
		printk("Bluetooth init failed (err %d)\n", ret);
		k_oops();
	}

	ret = bt_le_adv_start(BT_LE_ADV_PARAM(BT_LE_ADV_OPT_CONNECTABLE | BT_LE_ADV_OPT_USE_NAME,
		BT_GAP_ADV_SLOW_INT_MIN, BT_GAP_ADV_SLOW_INT_MAX, NULL), ad, ARRAY_SIZE(ad), NULL, 0);
	if (ret) {
		printk("Advertising failed to start (err %d)\n", ret);
		k_oops();
	}
}

uint8_t *ble_response_prepare(size_t* max_size)
{
	__DMB();
	ble_response_size = 0;
	__DMB();
	*max_size = sizeof(ble_response);
	return ble_response;
}

void ble_response_send(size_t size)
{
	__DMB();
	ble_response_size = size;
	__DMB();
}

const uint8_t *ble_request_get(size_t* size)
{
	int request_size_copy;
	__DMB();
	request_size_copy = ble_request_size;
	ble_request_size = 0;
	request_id = 255;
	request_offset = 0;
	__DMB();
	*size = request_size_copy;
	if (request_size_copy == 0) {
		return NULL;
	} else {
		return ble_request;
	}
}
```

## src/ble.h
```c
#ifndef _ble_h_
#define _ble_h_

#include <stdint.h>
#include <stdbool.h>

void ble_init();

uint8_t *ble_response_prepare(size_t* max_size);
void ble_response_send(size_t size);

const uint8_t *ble_request_get(size_t* size);

// callbacks
void ble_packet();

#endif
```

## src/blecmd.c
```c
#include <zephyr/kernel.h>
#include <zephyr/logging/log.h>
#include <zephyr/drivers/gpio.h>
#include <zephyr/bluetooth/bluetooth.h>
#include <zephyr/bluetooth/hci.h>
#include <zephyr/bluetooth/conn.h>
#include <zephyr/bluetooth/uuid.h>
#include <zephyr/bluetooth/gatt.h>
#include <mpsl/mpsl_work.h>
#include <mpsl_timeslot.h>
#include <mpsl.h>
#include <hal/nrf_timer.h>

#include "calendar.h"
#include "multiproto.h"
#include "leds.h"
#include "radio.h"
#include "ble.h"
#include "data.h"

#define LOG_LEVEL CONFIG_DEFAULT_LOG_LEVEL
#include <zephyr/logging/log.h>
LOG_MODULE_REGISTER(temp_blecmd);


#define CMD_GET_UP_TIME 1
#define CMD_READ 2
#define CMD_WRITE 3
#define CMD_KEEP 4

#define STATUS_OK 0
#define STATUS_UNKNOWN_CMD 1
#define STATUS_OUT_OF_BOUNDS 2

#define PACKET_HEADER_SIZE 4


typedef struct {
	uint8_t cmd;
	uint8_t tag;
	uint16_t id;
	union
	{
		struct {
			uint16_t offset;
			uint16_t size;
		} read;
		struct {
			uint16_t offset;
			uint8_t buffer[0];
		} write;
	};
} Request;

typedef struct {
	uint8_t cmd;
	uint8_t status;
	uint16_t id;
	union
	{
		struct {
			uint32_t time;
		} get_up_time;
		struct {
			uint8_t buffer[0];
		} read;
	};
} Response;


static void on_packet_work_handler(struct k_work *work)
{
	size_t req_size;
	size_t res_max_size;
	const Request* req = (const Request*)ble_request_get(&req_size);
	Response* res = (Response*)ble_response_prepare(&res_max_size);
	void* response_end = (uint8_t*)res + PACKET_HEADER_SIZE;
	if (req == NULL || res == NULL) {
		return;
	}
	uint8_t* mem = req->tag == 0 ? (uint8_t*)&data_config : (uint8_t*)&data_state;
	size_t mem_size = req->tag == 0 ? sizeof(data_config) : sizeof(data_state);
	res->cmd = req->cmd;
	res->status = STATUS_OK;
	res->id = req->id;
	switch (req->cmd)
	{
	case CMD_GET_UP_TIME:
		res->get_up_time.time = k_uptime_get() / (int64_t)1000;
		response_end = &res->get_up_time.time + 1;
		break;
	case CMD_READ: {
		LOG_DBG("READ %d from %d\n", req->read.size, req->read.offset);
		if ((size_t)req->read.size > res_max_size - PACKET_HEADER_SIZE
			|| (size_t)req->read.offset + (size_t)req->read.size > mem_size
			|| req->tag > 1) {
			res->status = STATUS_OUT_OF_BOUNDS;
			break;
		}
		memcpy(res->read.buffer, mem + (size_t)req->read.offset, req->read.size);
		response_end = &res->read.buffer[req->read.size];
		break;
	}
	case CMD_WRITE: {
		size_t write_size = req_size - offsetof(Request, write.buffer);
		LOG_DBG("WRITE %d to %d\n", write_size, req->write.offset);
		if (write_size + (size_t)req->write.offset > mem_size || req->tag > 1) {
			res->status = STATUS_OUT_OF_BOUNDS;
			break;
		}
		memcpy(mem + (size_t)req->write.offset, req->write.buffer, write_size);
		break;
	}
	case CMD_KEEP:
		LOG_ERR("TODO: save config!\n");
		break;
	default:
		res->status = STATUS_UNKNOWN_CMD;
		break;
	}

	ble_response_send((uint8_t*)response_end - (uint8_t*)res);
}


K_WORK_DEFINE(on_packet_work, on_packet_work_handler);


void ble_packet() {
	k_work_submit(&on_packet_work);
}
```

## src/blecmd.h
```c
#ifndef _blecmd_h_
#define _blecmd_h_



#endif // _blecmd_h_
```

## src/calendar.c
```c
#include "calendar.h"

static const int SECONDS_PER_MINUTE = 60;
static const int SECONDS_PER_HOUR = 60 * SECONDS_PER_MINUTE;
static const int SECONDS_PER_DAY = 24 * SECONDS_PER_HOUR;
static const int DAYS_PER_LEAP_YEAR = 366;
static const int DAYS_PER_COMMON_YEAR = 365;
static const int DAYS_PER_COMMON_4_YEARS = 4 * DAYS_PER_COMMON_YEAR + 1;
static const int DAYS_PER_COMMON_100_YEARS = 25 * DAYS_PER_COMMON_4_YEARS - 1;
static const int DAYS_PER_400_YEARS = 4 * DAYS_PER_COMMON_100_YEARS + 1;
static const int DAYS_BEFORE_1970 = 719528;
static const int FIRST_DAY_OF_WEAK_OF_YEAR_0 = 6;


static int days_before_month(int month, bool leap_year) {
	int days = (month * 214 + 3) / 7;
	if (month >= 2) {
		days -= leap_year ? 1 : 2;
	}
	return days;
}


static int days_of_month(int month, bool leap_year) {
	month++;
	int days = 30 + ((month ^ (month >> 3)) & 1);
	if (month == 2) {
		days -= leap_year ? 1 : 2;
	}
	return days;
}


static void days_from_0_to_date(int day_from_0, DateTime* date) {
	int c400;
	int c100;
	int c4;
	int c1;
	int day_of_year;
	int year;
	int month;
	int day;
	bool leap;

	// TODO: if CALENDAR_SHORT_TIMESTAMP then only every 4 years rule applies, so other rules can be removed
	date->day_of_week = (FIRST_DAY_OF_WEAK_OF_YEAR_0 + day_from_0) % 7;
	c400 = day_from_0 / DAYS_PER_400_YEARS;
	day_of_year = day_from_0 % DAYS_PER_400_YEARS;
	year = 400 * c400;
	leap = true;
	if (day_of_year >= DAYS_PER_LEAP_YEAR) {
		day_of_year = day_of_year - 1;
		c100 = day_of_year / DAYS_PER_COMMON_100_YEARS;
		day_of_year = day_of_year % DAYS_PER_COMMON_100_YEARS;
		year += 100 * c100;
		leap = false;
		if (day_of_year >= DAYS_PER_COMMON_YEAR) {
			day_of_year = day_of_year + 1;
			c4 = day_of_year / DAYS_PER_COMMON_4_YEARS;
			day_of_year = day_of_year % DAYS_PER_COMMON_4_YEARS;
			year += 4 * c4;
			leap = true;
			if (day_of_year >= DAYS_PER_LEAP_YEAR) {
				day_of_year = day_of_year - 1;
				c1 = day_of_year / DAYS_PER_COMMON_YEAR;
				day_of_year = day_of_year % DAYS_PER_COMMON_YEAR;
				year += c1;
				leap = false;
			}
		}
	}
	if (leap) {
		month = (day_of_year * 2 + 2) / 61;
	} else {
		month = (day_of_year * 50 + 107) / 1526;
	}
	day = day_of_year - days_before_month(month, leap);
	if (day < 0) {
		month -= 1;
		day = 31 + day;
	}
	date->year = year;
	date->month = month + 1;
	date->day = day + 1;
	date->leap = leap;
}

static int normalize_date(const DateTime* date, int* time_of_day_ptr)
{
	// Adjust and convert date
	bool leap;
	int leap_years;
	int days_from_0;
	int time_of_day;
	int year = date->year;
	int month = date->month - 1;
	int day = date->day - 1;
	int hour = date->hour;
	int min = date->min;
	int sec = date->sec;
	int months_from_0 = year * 12 + month;

	year = months_from_0 / 12;
	month = months_from_0 % 12;
	leap_years = (year + 3) / 4;
	leap_years -= (year + 99) / 100;
	leap_years += (year + 399) / 400;
	days_from_0 = year * DAYS_PER_COMMON_YEAR + leap_years;
	leap = (!(year % 4) && (year % 100)) || !(year % 400);
	days_from_0 += days_before_month(month, leap);
	days_from_0 += day;

	// Adjust time, add it to days if needed, and convert it to seconds from midnight
	time_of_day = sec + 60 * (min + 60 * hour);
	if (time_of_day < 0) {
		int sub_days = (-time_of_day + SECONDS_PER_DAY - 1) / SECONDS_PER_DAY;
		days_from_0 -= sub_days;
		time_of_day += SECONDS_PER_DAY * sub_days;
	} else {
		days_from_0 += time_of_day / SECONDS_PER_DAY;
		time_of_day %= SECONDS_PER_DAY;
	}

	*time_of_day_ptr = time_of_day;
	return days_from_0;
}

static int calc_transition_day(const DaylightTransition* tr, int day, int day_of_week, bool leap) {
	if (tr->day < 0) {
		return -tr->day;
	}
	int tr_month = tr->month - 1;
	int tr_day = tr->day;
	int tr_week = tr->week;
	day--;
	int days_per_month = days_of_month(tr_month, leap);
	if (tr_week >= 0) {
		int first_day_of_month = (day_of_week - day + 35) % 7;
		int first_tr_day_of_month = tr_day - first_day_of_month;
		if (first_tr_day_of_month < 0) {
			first_tr_day_of_month += 7;
		}
		int tr_day_of_month = first_tr_day_of_month + 7 * tr_week;
		while (tr_day_of_month >= days_per_month) {
			tr_day_of_month -= 7;
		}
		return tr_day_of_month + 1;
	} else {
		int last_day_of_month = (day_of_week - day + days_per_month + 6) % 7;
		int last_tr_day_of_month = days_per_month - 1 + tr_day - last_day_of_month;
		if (last_tr_day_of_month < days_per_month) {
			last_tr_day_of_month += 7;
		}
		int tr_day_of_month = last_tr_day_of_month + 7 * tr_week;
		while (tr_day_of_month < 0) {
			tr_day_of_month += 7;
		}
		return tr_day_of_month + 1;
	}
}

static bool is_daylight_enabled(const DateTime* date, int time_of_day, const TimeZone* tz, int delta)
{
	int day = date->day;
	if (tz->daylight_delta == 0 || date->month < tz->daylight_start.month || date->month > tz->daylight_end.month) {
		return false;
	} else if (date->month > tz->daylight_start.month && date->month < tz->daylight_end.month) {
		return true;
	} else if (date->month == tz->daylight_start.month) {
		int tr_day = calc_transition_day(&tz->daylight_start, day, date->day_of_week, date->leap);
		if (day < tr_day) {
			return false;
		} else if (day > tr_day) {
			return true;
		} else if (time_of_day < (int)tz->daylight_start.time * SECONDS_PER_MINUTE + delta) {
			return false;
		} else {
			return true;
		}
	} else {
		int tr_day = calc_transition_day(&tz->daylight_end, day, date->day_of_week, date->leap);
		if (day < tr_day) {
			return true;
		} else if (day > tr_day) {
			return false;
		} else if (time_of_day < (int)tz->daylight_end.time * SECONDS_PER_MINUTE + delta) {
			return true;
		} else {
			return false;
		}
	}
}

void convert_time_utc(TimeStamp time, DateTime* date) {
	int day_from_1970 = time / (TimeStamp)SECONDS_PER_DAY;
	int time_of_day = time - (TimeStamp)SECONDS_PER_DAY * (TimeStamp)day_from_1970;
	int day_from_0 = DAYS_BEFORE_1970 + day_from_1970;
	days_from_0_to_date(day_from_0, date);
	date->sec = time_of_day % 60;
	time_of_day /= 60;
	date->min = time_of_day % 60;
	date->hour = time_of_day / 60;
}


TimeStamp make_time_utc(const DateTime* date)
{
	int time_of_day;
	int days_from_0 = normalize_date(date, &time_of_day);
	return (TimeStamp)(days_from_0 - DAYS_BEFORE_1970) * (TimeStamp)SECONDS_PER_DAY + (TimeStamp)time_of_day;
}

void convert_time_tz(TimeStamp time, DateTime* date, const TimeZone* tz) {
	TimeStamp tz_time = time + (TimeStamp)tz->utc_offset * SECONDS_PER_MINUTE;
	convert_time_utc(tz_time, date);
	int time_of_day = (int)date->sec + 60 * ((int)date->min + 60 * (int)date->hour);
	if (is_daylight_enabled(date, time_of_day, tz, 0)) {
		convert_time_utc(tz_time + (TimeStamp)tz->daylight_delta * SECONDS_PER_MINUTE, date);
	}
}

TimeStamp make_time_tz(const DateTime* date, const TimeZone* tz)
{
	DateTime temp_date;
	int time_of_day;
	int days_from_0 = normalize_date(date, &time_of_day);
	TimeStamp result = (TimeStamp)(days_from_0 - DAYS_BEFORE_1970) * (TimeStamp)SECONDS_PER_DAY + (TimeStamp)time_of_day - (TimeStamp)tz->utc_offset * (TimeStamp)SECONDS_PER_MINUTE;
	days_from_0_to_date(days_from_0, &temp_date);
	if (is_daylight_enabled(&temp_date, time_of_day, tz, (TimeStamp)tz->daylight_delta * SECONDS_PER_MINUTE)) {
		result -= (TimeStamp)tz->daylight_delta * SECONDS_PER_MINUTE;
	}
	return result;
}
```

## src/calendar.h
```c
#ifndef _calendar_h_
#define _calendar_h_

#include <stdint.h>
#include <stdbool.h>

#include "data.h"

#ifdef CALENDAR_SHORT_TIMESTAMP
typedef int32_t TimeStamp;
#else
typedef int64_t TimeStamp;
#endif

typedef struct {
	int16_t year;
	int16_t month;
	int16_t day;
	int16_t hour;
	int16_t min;
	int16_t sec;
	bool leap;
	uint8_t day_of_week;
} DateTime;


void convert_time_utc(TimeStamp time, DateTime* date);
TimeStamp make_time_utc(const DateTime* date);
void convert_time_tz(TimeStamp time, DateTime* date, const TimeZone* tz);
TimeStamp make_time_tz(const DateTime* date, const TimeZone* tz);

#endif
```

## src/data.c
```c
#include "data.h"


Config data_config;
State data_state;


void data_config_keep()
{

}

void data_init()
{
	//data_config.hash = DATA_HASH;
}
```

## src/data.h
```c
#ifndef _data_h_
#define _data_h_

#include <stdint.h>
#include <stdbool.h>

#include "hash.h"

typedef struct {
	int16_t time; // relative to base utc_offset
	int8_t month;
	int8_t day; // negative for fixed, positive or zero for floating
	int8_t week; // negative counts backwards from end of month
} DaylightTransition;

typedef struct {
	int16_t utc_offset;
	int16_t daylight_delta; // Daylight disabled if zero
	DaylightTransition daylight_start;
	DaylightTransition daylight_end;
} TimeZone;

typedef enum {
	FUNC_MIN,
	FUNC_MAX,
	FUNC_AVG,
} ChannelFunction;

typedef struct {
	uint32_t addr_low;
	uint16_t addr_high;
	uint8_t channel;
	char name[48];
} ConfigNode;

typedef struct {
	uint8_t func;
	char name[48];
} ConfigChannel;

typedef struct {
	uint8_t config_version;
	uint8_t node_count;
	uint8_t channel_count;
	uint8_t _reserved_1;
	TimeZone time_zone;
	ConfigNode nodes[32];
	ConfigChannel channels[8];
} Config;

typedef struct {
	uint32_t last_update;
	uint16_t temperature;
	uint16_t voltage;
} StateNode;

typedef struct {
	uint16_t temperature;
} StateChannel;

typedef struct {
	volatile uint32_t time_shift;
	StateNode nodes[32];
	StateChannel channels[8];
} State;

extern Config data_config;
extern State data_state;

void data_config_keep();
void data_init();

#endif // _data_h_
```

## src/hash.h
```c
#define DATA_HASH 0x02c77268b8211308uLL
```

## src/leds.h
```c
#ifndef _leds_h_
#define _leds_h_

static inline void led_off(int n) {
	NRF_P0->OUTSET = (1 << (13 + n));
}

static inline void led_on(int n) {
	NRF_P0->OUTCLR = (1 << (13 + n));
}

static inline void led_toggle(int n) {
	uint32_t mask = (1 << (13 + n));
	if (NRF_P0->OUT & mask) {
		NRF_P0->OUTCLR = mask;
	} else {
		NRF_P0->OUTSET = mask;
	}
}

static inline void led_set(int n, int value) {
	uint32_t mask = (1 << (13 + n));
	if (value) {
		NRF_P0->OUTCLR = mask;
	} else {
		NRF_P0->OUTSET = mask;
	}
}

static inline void leds_init() {
	NRF_P0->PIN_CNF[13] = 1;
	NRF_P0->PIN_CNF[14] = 1;
	NRF_P0->PIN_CNF[15] = 1;
	NRF_P0->PIN_CNF[16] = 1;
	led_off(0);
	led_off(1);
	led_off(2);
	led_off(3);
}

#endif
```

## src/multiproto.c
```c
#include <zephyr/kernel.h>
#include <mpsl.h>
#include <mpsl_timeslot.h>
#include <mpsl/mpsl_work.h>
#include <hal/nrf_timer.h>

#include "leds.h"
#include "multiproto.h"

/* Timeslot calculation
	RX ramp up:              140
	On air output packet:    544 = 8 (preamble) + 16 (base) + 8 (prefix) + 80 (payload) + 24 (crc) = 136 bits / 250000 kbit/s
	RX disable:                4
	packet process:          100
	TX ramp up:              140
	On air input packet:     544 = 8 (preamble) + 16 (base) + 8 (prefix) + 80 (payload) + 24 (crc) = 136 bits / 250000 kbit/s
	TX disable:               15
				-----
				1487 us
	Margin:                 +200 us
*/
static const uint32_t TIME_SLOT_MARGIN_US = 200;
static const uint32_t TIME_SLOT_US = 1500 + TIME_SLOT_MARGIN_US;

// Time needed to "jump" over BLE advertizing
static const uint32_t ADV_SLOT_TIME_US = 6000;
static const uint32_t ADV_JUMP_TIME_US = ADV_SLOT_TIME_US * 4 / 3;

// MPSL timeslot request (first)
static mpsl_timeslot_request_t timeslot_request_earliest = {
	.request_type = MPSL_TIMESLOT_REQ_TYPE_EARLIEST,
	.params.earliest.hfclk = MPSL_TIMESLOT_HFCLK_CFG_XTAL_GUARANTEED,
	.params.earliest.priority = MPSL_TIMESLOT_PRIORITY_NORMAL,
	.params.earliest.length_us = TIME_SLOT_US,
	.params.earliest.timeout_us = 1000000
};

// MPSL timeslot request (next)
static mpsl_timeslot_request_t timeslot_request_normal = {
	.request_type = MPSL_TIMESLOT_REQ_TYPE_NORMAL,
	.params.normal.hfclk = MPSL_TIMESLOT_HFCLK_CFG_XTAL_GUARANTEED,
	.params.normal.priority = MPSL_TIMESLOT_PRIORITY_NORMAL,
	.params.normal.length_us = TIME_SLOT_US
};

// Work for requesting a new timeslot
static struct k_work request_slot_work;

// MPSL session id
static mpsl_timeslot_session_id_t session_id = 0xFFu;

static uint32_t end_time_us = 0;

static mpsl_timeslot_signal_return_param_t signal_callback_return_param;


static void safe_set_cc(nrf_timer_cc_channel_t channel, int time)
{
	uint32_t counter;
	uint32_t new_counter;
	if (time < 5) {
		time = 5;
	}
	nrf_timer_task_trigger(NRF_TIMER0, nrf_timer_capture_task_get(NRF_TIMER_CC_CHANNEL3));
	new_counter = nrf_timer_cc_get(NRF_TIMER0, NRF_TIMER_CC_CHANNEL3);
	do {
		counter = new_counter;
		nrf_timer_cc_set(NRF_TIMER0, channel, counter + time);
		nrf_timer_task_trigger(NRF_TIMER0, nrf_timer_capture_task_get(NRF_TIMER_CC_CHANNEL3));
		new_counter = nrf_timer_cc_get(NRF_TIMER0, NRF_TIMER_CC_CHANNEL3);
	} while (new_counter > counter + 1);
}


static void handle_callback(MultiProtoEvent event, bool allow_fast_end)
{
	int req = multiproto_callback(event);

	if (req == MULTIPROTO_REQ_CONTINUE) {
		// nothing to do
	} else if (req == MULTIPROTO_REQ_END) {
		if (allow_fast_end) {
			nrf_timer_int_disable(NRF_TIMER0, NRF_TIMER_INT_COMPARE0_MASK | NRF_TIMER_INT_COMPARE1_MASK | NRF_TIMER_INT_COMPARE2_MASK);
			led_on(3);
			timeslot_request_normal.params.normal.distance_us = end_time_us + ADV_JUMP_TIME_US;
			signal_callback_return_param.params.request.p_next = &timeslot_request_normal;
			signal_callback_return_param.callback_action = MPSL_TIMESLOT_SIGNAL_ACTION_REQUEST;
		} else {
			safe_set_cc(NRF_TIMER_CC_CHANNEL1, 0);
		}
	} else {
		safe_set_cc(NRF_TIMER_CC_CHANNEL2, req);
	}
}


static mpsl_timeslot_signal_return_param_t *mpsl_timeslot_callback(mpsl_timeslot_session_id_t session_id, uint32_t signal_type)
{
	signal_callback_return_param.callback_action = MPSL_TIMESLOT_SIGNAL_ACTION_NONE;

	switch (signal_type) {

	case MPSL_TIMESLOT_SIGNAL_START:
		end_time_us = TIME_SLOT_US;
		nrf_timer_int_disable(NRF_TIMER0, NRF_TIMER_INT_COMPARE0_MASK | NRF_TIMER_INT_COMPARE1_MASK | NRF_TIMER_INT_COMPARE2_MASK | NRF_TIMER_INT_COMPARE2_MASK);
		nrf_timer_cc_set(NRF_TIMER0, NRF_TIMER_CC_CHANNEL0, end_time_us - TIME_SLOT_MARGIN_US);
		nrf_timer_event_clear(NRF_TIMER0, NRF_TIMER_EVENT_COMPARE0);
		nrf_timer_cc_set(NRF_TIMER0, NRF_TIMER_CC_CHANNEL1, 0xFFFFFFFF);
		nrf_timer_event_clear(NRF_TIMER0, NRF_TIMER_EVENT_COMPARE1);
		nrf_timer_cc_set(NRF_TIMER0, NRF_TIMER_CC_CHANNEL2, 0xFFFFFFFF);
		nrf_timer_event_clear(NRF_TIMER0, NRF_TIMER_EVENT_COMPARE2);
		nrf_timer_int_enable(NRF_TIMER0, NRF_TIMER_INT_COMPARE0_MASK | NRF_TIMER_INT_COMPARE1_MASK | NRF_TIMER_INT_COMPARE2_MASK);
		led_off(3);
		handle_callback(MULTIPROTO_EV_START, false);
		break;

	case MPSL_TIMESLOT_SIGNAL_TIMER0:
		if (nrf_timer_event_check(NRF_TIMER0, NRF_TIMER_EVENT_COMPARE0)) {
			nrf_timer_event_clear(NRF_TIMER0, NRF_TIMER_EVENT_COMPARE0);
			signal_callback_return_param.callback_action = MPSL_TIMESLOT_SIGNAL_ACTION_EXTEND;
			signal_callback_return_param.params.extend.length_us = TIME_SLOT_US;
		}

		if (nrf_timer_event_check(NRF_TIMER0, NRF_TIMER_EVENT_COMPARE1)) {
			nrf_timer_int_disable(NRF_TIMER0, NRF_TIMER_INT_COMPARE0_MASK | NRF_TIMER_INT_COMPARE1_MASK | NRF_TIMER_INT_COMPARE2_MASK);
			led_on(3);
			timeslot_request_normal.params.normal.distance_us = end_time_us + ADV_JUMP_TIME_US;
			signal_callback_return_param.params.request.p_next = &timeslot_request_normal;
			signal_callback_return_param.callback_action = MPSL_TIMESLOT_SIGNAL_ACTION_REQUEST;
		} else if (nrf_timer_event_check(NRF_TIMER0, NRF_TIMER_EVENT_COMPARE2)) {
			nrf_timer_event_clear(NRF_TIMER0, NRF_TIMER_EVENT_COMPARE2);
			handle_callback(MULTIPROTO_EV_TIMER, true);
		}
		break;

	case MPSL_TIMESLOT_SIGNAL_EXTEND_FAILED:
		handle_callback(MULTIPROTO_EV_END, false);
		break;

	case MPSL_TIMESLOT_SIGNAL_EXTEND_SUCCEEDED:
		end_time_us += TIME_SLOT_US;
		nrf_timer_cc_set(NRF_TIMER0, NRF_TIMER_CC_CHANNEL0, end_time_us - TIME_SLOT_MARGIN_US);
		break;

	case MPSL_TIMESLOT_SIGNAL_RADIO:
		handle_callback(MULTIPROTO_EV_RADIO, true);
		break;

	case MPSL_TIMESLOT_SIGNAL_BLOCKED:
		mpsl_work_submit(&request_slot_work);
		break;

	case MPSL_TIMESLOT_SIGNAL_CANCELLED:
		mpsl_work_submit(&request_slot_work);
		break;

	case MPSL_TIMESLOT_SIGNAL_INVALID_RETURN:
	case MPSL_TIMESLOT_SIGNAL_OVERSTAYED:
	case MPSL_TIMESLOT_SIGNAL_SESSION_IDLE:
	case MPSL_TIMESLOT_SIGNAL_SESSION_CLOSED:
	default:
		break;
	}

	return &signal_callback_return_param;
}


static void work_handler(struct k_work *work)
{
	static bool session_opened = false;
	int err;
	if (!session_opened) {
		err = mpsl_timeslot_session_open(mpsl_timeslot_callback, &session_id);
		if (err) {
			printk("Timeslot session open error: %d\n", err);
			k_oops();
		}
		session_opened = true;
		mpsl_work_submit(&request_slot_work);
		return;
	}
	err = mpsl_timeslot_request(session_id, &timeslot_request_earliest);
	if (err) {
		printk("Timeslot request error: %d\n", err);
		k_oops();
	}
}


void multiproto_init()
{
	led_on(3);
	k_work_init(&request_slot_work, work_handler);
	mpsl_work_submit(&request_slot_work);
}
```
